## main/Kconfig.projbuild
```kconfig
menu "Example Configuration"

    choice LCD_CONTROLLER
        prompt "LCD controller model"
        default LCD_CONTROLLER_SSD1306
        help
            Select LCD controller model

        config LCD_CONTROLLER_SSD1306
            bool "SSD1306"

        config LCD_CONTROLLER_SH1107

            bool "SH1107"
    endchoice

    if LCD_CONTROLLER_SSD1306
        choice SSD1306_HEIGHT

            prompt "SSD1306 Height in pixels"
            default SSD1306_HEIGHT_64

            help
                Height of the display in pixels. a.k.a vertical resolution

            config SSD1306_HEIGHT_64

                bool "64"
            config SSD1306_HEIGHT_32

                bool "32"
        endchoice

        config SSD1306_HEIGHT

            int
            default 64 if SSD1306_HEIGHT_64

            default 32 if SSD1306_HEIGHT_32

    endif

endmenu
```

## sdkconfig.defaults
```kconfig
# Default sdkconfig parameters to use the OTA
# partition table layout, with a 4MB flash size
CONFIG_ESPTOOLPY_FLASHSIZE_4MB=y

# Use custom partition table
CONFIG_PARTITION_TABLE_CUSTOM=y
CONFIG_PARTITION_TABLE_CUSTOM_FILENAME="partitions.csv"
CONFIG_PARTITION_TABLE_FILENAME="partitions.csv"


CONFIG_LV_CONF_SKIP=y
CONFIG_LV_USE_OBSERVER=y
CONFIG_LV_USE_SYSMON=y
```
